## kernel/defconfig/genesis_j6lte_defconfig
```kconfig
# Genesis OS J6 — privacy-hardened defconfig
# Base: arch/arm64/configs/exynos7870-j6lte_defconfig (LineageOS 18.1)
# Overrides for privacy, security, and Spider-Web mesh networking

CONFIG_LOCALVERSION="-genesis-j6lte"
CONFIG_DEFAULT_HOSTNAME="genesis"

# --- Security / SELinux ---
CONFIG_SECURITY_SELINUX=y
CONFIG_SECURITY_SELINUX_BOOTPARAM=n
CONFIG_SECURITY_SELINUX_DEVELOP=n
CONFIG_AUDIT=y

# --- Reduce kernel info leakage ---
CONFIG_IKCONFIG=n
CONFIG_IKCONFIG_PROC=n
CONFIG_KALLSYMS=n
CONFIG_PROC_VMCORE=n

# --- Reduce attack surface ---
CONFIG_KPROBES=n
CONFIG_KPROBES_ON_FTRACE=n
CONFIG_USERFAULTFD=n
CONFIG_BPF_SYSCALL=n
CONFIG_ACCT=n

# --- Network: Spider-Web mesh support ---
CONFIG_IPV6=y
CONFIG_IPV6_PRIVACY=y
CONFIG_NETFILTER=y
CONFIG_NETFILTER_XT_MATCH_OWNER=y
CONFIG_NF_CONNTRACK=y
CONFIG_WIREGUARD=y

# --- Firewall (per-app blocking via iptables) ---
CONFIG_IP_NF_IPTABLES=y
CONFIG_IP_NF_FILTER=y
CONFIG_IP6_NF_IPTABLES=y
CONFIG_IP6_NF_FILTER=y

# --- Hardening ---
CONFIG_STRICT_KERNEL_RWX=y
CONFIG_STRICT_MODULE_RWX=y
CONFIG_SHADOW_CALL_STACK=y
CONFIG_STACKPROTECTOR=y
CONFIG_STACKPROTECTOR_STRONG=y
CONFIG_RANDOMIZE_BASE=y
CONFIG_RANDOMIZE_MODULE_REGION_FULL=y

# --- Debugging (disable for release) ---
CONFIG_DEBUG_KERNEL=n
CONFIG_DEBUG_FS=n
```
